## layers/meta-stone-ocean/conf/layer.conf
```bitbake
BBPATH .= ":${LAYERDIR}"

BBFILES += "${LAYERDIR}/recipes-*/*/*.bb \
            ${LAYERDIR}/recipes-*/*/*.bbappend"

BBFILE_COLLECTIONS += "stone-ocean"
BBFILE_PATTERN_stone-ocean = "^${LAYERDIR}/"
BBFILE_PRIORITY_stone-ocean = "10"

LAYERDEPENDS_stone-ocean = "core"
LAYERSERIES_COMPAT_stone-ocean = "wrynose"
```
